## arch/arm/configs/cyanogen_apexq_defconfig
```kconfig
CONFIG_MACH_MSM_DUMMY=y
# CONFIG_MACH_M2 is not set
CONFIG_MACH_APEXQ=y
# CONFIG_HAVE_END_MEM is not set
# CONFIG_MSM_BAM_DMUX_NOLOCK is not set
# CONFIG_WIFI_CONTROL_FUNC is not set
CONFIG_MSM_WCNSS_SSR_8960=y
CONFIG_IOMMU_API=y
# CONFIG_BT_BCM4334 is not set
# CONFIG_MSM_L1_RECOV_ERR_PANIC is not set
CONFIG_MSM_DCVS_FOR_MSM8260A=y
# CONFIG_KEXEC is not set
CONFIG_XFRM_SUB_POLICY=y
CONFIG_XFRM_MIGRATE=y
CONFIG_XFRM_STATISTICS=y
CONFIG_INET_IPCOMP=y
CONFIG_INET_XFRM_TUNNEL=y
CONFIG_L2TP=y
# CONFIG_L2TP_DEBUGFS is not set
# CONFIG_L2TP_V3 is not set
# CONFIG_NET_ACT_POLICE is not set
# CONFIG_NET_ACT_GACT is not set
# CONFIG_NET_ACT_MIRRED is not set
CONFIG_WIRELESS_EXT=y
CONFIG_WEXT_SPY=y
CONFIG_WEXT_PRIV=y
CONFIG_YAS_532_ENABLE=y
CONFIG_OPTICAL_TAOS_TRITON=y
# CONFIG_SENSORS_CM36651 is not set
# CONFIG_VP_A2220 is not set
# CONFIG_MPU_SENSORS_AK8975_411 is not set
# CONFIG_MPU_SENSORS_YAS529_411 is not set
CONFIG_INPUT_YAS_SENSORS=y
# CONFIG_INPUT_YAS_ACCELEROMETER is not set
# CONFIG_YAS_ACC_DRIVER_LIS3DH is not set
# CONFIG_YAS_ACC_DRIVER_BMA250 is not set
# CONFIG_YAS_ACC_MULTI_SUPPORT is not set
CONFIG_INPUT_YAS_MAGNETOMETER=y
CONFIG_YAS_MAG_DRIVER_YAS532=y
CONFIG_INPUT_YAS_MAGNETOMETER_POSITION=5
# CONFIG_INPUT_YAS_ORIENTATION is not set
# CONFIG_PPPOL2TP is not set
CONFIG_WCNSS_CORE=y
CONFIG_WCNSS_MEM_PRE_ALLOC=y
# CONFIG_BCM4334 is not set
# CONFIG_BCM4335 is not set
CONFIG_KEYBOARD_ADP5588=y
# CONFIG_TOUCHSCREEN_MMS144 is not set
CONFIG_TOUCHSCREEN_MXT224=y
# CONFIG_INPUT_BMP180 is not set
CONFIG_SLIMBUS_MSM_CTRL=y
# CONFIG_BATTERY_MAX17040 is not set
# CONFIG_BATTERY_CTIA is not set
# CONFIG_BATTERY_SEC is not set
# CONFIG_WIRELESS_CHARGING is not set
# CONFIG_CHARGER_SMB347 is not set
# CONFIG_REGULATOR_MAX8952 is not set
# CONFIG_RC_CORE is not set
CONFIG_ISX012=y
# CONFIG_S5C73M3 is not set
# CONFIG_S5K6A3YX is not set
# CONFIG_S5K4ECGX is not set
# CONFIG_S5K5CCGX is not set
CONFIG_DB8131M=y
# CONFIG_SR030PC50 is not set
# CONFIG_FB_MSM_LOGO is not set
# CONFIG_SAMSUNG_CMC624 is not set
# CONFIG_FB_MSM_MIPI_SAMSUNG_OLED_VIDEO_HD_PT is not set
CONFIG_FB_MSM_MIPI_SAMSUNG_OLED_VIDEO_WVGA_PT=y
# CONFIG_FB_MSM_MIPI_SAMSUNG_OLED_VIDEO_HD_PT_PANEL is not set
CONFIG_FB_MSM_MIPI_SAMSUNG_OLED_VIDEO_WVGA_PT_PANEL=y
CONFIG_MMC_PERF_PROFILING=y
# CONFIG_MMC_MSM_SDC4_SUPPORT is not set
# CONFIG_LEDS_AAT1290A is not set
# CONFIG_LEDS_MSM_TKEY is not set
CONFIG_LEDS_MSM_KB=y
CONFIG_PRIMA_WLAN=m
# CONFIG_PRIMA_WLAN_BTAMP is not set
CONFIG_PRIMA_WLAN_LFR=y
CONFIG_PRIMA_WLAN_OKC=y
CONFIG_PRIMA_WLAN_11AC_HIGH_TP=y
# CONFIG_WLAN_FEATURE_11W is not set
# CONFIG_QCOM_VOWIFI_11R is not set 
CONFIG_BATTERY_SAMSUNG=y
# CONFIG_FUELGAUGE_DUMMY is not set
# CONFIG_FUELGAUGE_MAX17042 is not set
CONFIG_FUELGAUGE_MAX17048=y
# CONFIG_FUELGAUGE_MAX17050 is not set
# CONFIG_CHARGER_DUMMY is not set
# CONFIG_CHARGER_SMB328 is not set
CONFIG_CHARGER_BQ24157=y
# CONFIG_CHARGER_BQ24190 is not set
# CONFIG_CHARGER_BQ24191 is not set
CONFIG_MSM_IOMMU=y
CONFIG_MSM_IOMMU_GPU_SYNC=y
CONFIG_IOMMU_PGTABLES_L2=y
CONFIG_FRAME_WARN=2048
# CONFIG_LOCKUP_DETECTOR is not set
# CONFIG_HARDLOCKUP_DETECTOR_OTHER_CPU is not set
# CONFIG_HARDLOCKUP_DETECTOR is not set
# CONFIG_DETECT_HUNG_TASK is not set
# CONFIG_SCHED_DEBUG is not set
CONFIG_FRAME_POINTER=y
CONFIG_DYNAMIC_FTRACE=y
# CONFIG_FUNCTION_PROFILER is not set
CONFIG_FTRACE_MCOUNT_RECORD=y
# CONFIG_FTRACE_STARTUP_TEST is not set
CONFIG_OLD_MCOUNT=y
# CONFIG_DEBUG_LL is not set
CONFIG_SEC_DEBUG=y
# CONFIG_SEC_DEBUG_SCHED_LOG is not set
# CONFIG_SEC_DEBUG_SEMAPHORE_LOG is not set
# CONFIG_SEC_DEBUG_USER is not set
CONFIG_SEC_DEBUG_SUBSYS=y
```

## drivers/misc/inv_mpu/compass/Kconfig
```kconfig
menuconfig INV_SENSORS_COMPASS
	bool "Compass Slave Sensors"
	default y
	---help---
	  Say Y here to get to see options for device drivers for various
	  compasses. This option alone does not add any kernel code.
	  If you say N, all options in this submenu will be skipped and disabled.

if INV_SENSORS_COMPASS

config MPU_SENSORS_AK8975_411
	tristate "AKM ak8975"
	help
	  This enables support for the AKM ak8975 compass
	  This support is for integration with the MPU3050 or MPU6050 gyroscope
	  device driver.  Only one compass can be registered at a time.
	  Specifying more that one compass in the board file will result
	  in runtime errors.

config MPU_SENSORS_AK8975_SELFTEST
	bool "Self-test of AKM ak8975 sensor"
	depends on MPU_SENSORS_AK8975_411
	default n
	help
	  Say Y here if you want support for self-test of the AKM ak8975 sensor
	  device.

endif
```

## drivers/video/msm/mhl_v2/Kconfig
```kconfig
#
# Copyright (c) 2011 Samsung Electronics Co., Ltd.
# 		http://www.samsung.com/
# Aakash Manik
#	aakash.manik@samsung.com


config VIDEO_MHL_V2
	bool "Samsung Mobile HD Link Interface"
	depends on MSM_VIDC && ARCH_MSM
	default n

config MHL_D3_SUPPORT
	bool "Support D3 mode in mhl"
	default n

config MHL_NEW_CBUS_MSC_CMD
	bool "Read DCAP for distinguish TA and USB"
	default n
	---help---
	  This is a MHL v2 driver customized for Qualcomm MSM8960 based chipsets.

config SAMSUNG_MHL_8240
	bool "Suppor Samsung MHL 8240"
	default n

config MHL_VERSION
	hex "Number of MHL Version"
	default 0x20
	---help---
	  MHL Version
	  For example, those device compliant
	  with MHL Specification version 2.0
	  shell set this MHL_VERSION to 0x20
```
